/dts-v1/;
/plugin/;
/ {
    compatible = "brcm,bcm2835";
    fragment@0 {
        target = <&i2c1>;
        __overlay__ {
            #address-cells = <1>;
            #size-cells = <0>;
            I2C_LCD: I2C_LCD@27 {
                compatible = "brightlight,MY_LCD";
                reg = <0x27>;
                status = "okay";
            };
        };
    };
};